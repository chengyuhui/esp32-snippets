## Kconfig
```kconfig
menu "nkolban's C++ wrappers"

config NKOLBAN
    bool "nkolban's C++ wrappers"
    default y
    help
        Select this option to use nkolban's C++ wrappers.

config NKOLBAN_BLE
    bool "Bluetooth wrappers"
    depends on BT_ENABLED && NKOLBAN
    default y
    help
        Select this option to use nkolban's C++ Bluetooth BLE wrappers.

config NKOLBAN_BLE2902
    bool "BLE2902"
    depends on NKOLBAN_BLE
    default y
    help
        Select this option to use nkolban's C++ Bluetooth BLE2902 wrappers.

endmenu
```
